AUTOSAR XML (schema 4.0)
package /Diagnostics
  base type WideCounter: base-type-size=128, base-type-encoding=NONE
  dlt message collection set Logs
    dlt message VoltageDrop: message-id=0x12345678, message-line-number=27, message-source-file=power_monitor.c, message-type-info=DLT_LOG_WARN
      dlt argument headline: length=0  # Voltage dropped
      dlt argument millivolts: length=16, network-representation={base-type=uint16, unit=mV}
      dlt argument event_count: length=128, network-representation={base-type=WideCounter, compu {phys=raw*0.5-7.922816251e+28; unit Events}}
  ecu instance PowerUnit
    dlt-config dlt-ecu-id=PWR1:
      dlt log channel PowerMonitor: application-id=POWR, context-id=VOLT, dlt-message=VoltageDrop
